#include "oledDriver.h"
#include <U8g2lib.h>
/**
 * @brief OLED display Colir One Logo
 */
const unsigned char PROGMEM logo[] = {
    0x00, 0x00, 0x00, 0x00, 0x00, 0x00, 0x00, 0x00, 0x00, 0x00, 0x00, 0x00, 0x00, 0x00, 0x00, 0x7F,
    0xF8, 0x00, 0x00, 0x00, 0x00, 0x00, 0x00, 0x00, 0x00, 0x00, 0x00, 0x00, 0x00, 0x00, 0x7F, 0xFC,
    0x00, 0x00, 0x00, 0x00, 0x00, 0x00, 0x00, 0x00, 0x00, 0x00, 0x00, 0x00, 0x00, 0x3F, 0xFE, 0x00,
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    0x00, 0x00, 0x00, 0x00, 0x00, 0x00, 0x00, 0x00, 0x00,
};

static U8G2_SSD1309_128X64_NONAME2_F_HW_I2C u8g2(U8G2_R0, /* reset=*/ U8X8_PIN_NONE, /* clock=*/ 22, /* data=*/ 21);
static oled_screen_t currentScreen;

void setCurrentScreen(oled_screen_t screen){
  currentScreen = screen;
}

oled_screen_t getCurrentScreen(void){
  return currentScreen;
}

void oledInit(void){
  u8g2.setBusClock(1000000);
  u8g2.begin();
  u8g2.setFont(u8g2_font_6x12_t_symbols);
  u8g2.enableUTF8Print();
  u8g2.setFontMode(1);
  u8g2.clearBuffer();
  u8g2.drawBitmap(4, 12, 15, 39, logo);// cnt = wid / 8, h = height
  u8g2.sendBuffer();  
}

void oledMainScreenDisplay(float verticalVelocity, float altitude){
  setCurrentScreen(MAIN_SCREEN);
  u8g2.clearBuffer();
  //Line 1
  u8g2.drawGlyph(0*FONT_WIDTH, FONT_HEIGHT, 0x2195); // 8 symbols before
  u8g2.setCursor(2*FONT_WIDTH, FONT_HEIGHT);
  u8g2.print("Velocity");
  u8g2.setCursor(10*FONT_WIDTH, FONT_HEIGHT); // 10 symbols before
  u8g2.print(":");
  u8g2.setCursor(13*FONT_WIDTH, FONT_HEIGHT); //13 or 14
  u8g2.print(String(verticalVelocity, 2) + "m/s");

  //Line 2
  u8g2.setCursor(0*FONT_WIDTH, 2*FONT_HEIGHT + LINE_SPACING);
  u8g2.print("Altitude:");
  u8g2.setCursor(13*FONT_WIDTH, 2*FONT_HEIGHT + LINE_SPACING); //13 or 14
  u8g2.print(String(altitude, 2) + "m");

  //Line 3
  const char* line3_str = "Shutes";
  u8g2.setCursor(OLED_CENTER*FONT_WIDTH - (strlen(line3_str) / 2)*FONT_WIDTH, 3*FONT_HEIGHT + LINE_SPACING*2);
  u8g2.print(line3_str);
  //Line 4
  u8g2.drawGlyph(0*FONT_WIDTH, 4*FONT_HEIGHT + LINE_SPACING*3, 0x2193);
  u8g2.setCursor(1*FONT_WIDTH, 4*FONT_HEIGHT + LINE_SPACING*3);
  u8g2.print("Open");
  const char* close_str = "Close";
  u8g2.setCursor((OLED_MAX_SYMBOLS_IN_1_LINE)*FONT_WIDTH - 1*FONT_WIDTH - (strlen(close_str)*FONT_WIDTH), 4*FONT_HEIGHT + LINE_SPACING*3);
  u8g2.print(close_str);
  u8g2.drawGlyph((OLED_MAX_SYMBOLS_IN_1_LINE)*FONT_WIDTH - 1*FONT_WIDTH, 4*FONT_HEIGHT + LINE_SPACING*3, 0x2193);
  u8g2.sendBuffer();
}

void confirmLauchCommandDisplay(void){
  setCurrentScreen(CONFIRM_SCREEN);
  u8g2.clearBuffer();

  u8g2.setCursor(1*FONT_WIDTH, (((OLED_MAX_LINES - 1)/2)*FONT_HEIGHT));
  u8g2.print("Send Launch Command?");

  // final line
  u8g2.drawGlyph(0*FONT_WIDTH, 4*FONT_HEIGHT + LINE_SPACING*3, 0x2193);
  u8g2.setCursor(1*FONT_WIDTH, 4*FONT_HEIGHT + LINE_SPACING*3);
  u8g2.print("No");
  const char* yes_str = "Yes";
  u8g2.setCursor((OLED_MAX_SYMBOLS_IN_1_LINE)*FONT_WIDTH - 1*FONT_WIDTH - (strlen(yes_str)*FONT_WIDTH), 4*FONT_HEIGHT + LINE_SPACING*3);
  u8g2.print(yes_str);
  u8g2.drawGlyph((OLED_MAX_SYMBOLS_IN_1_LINE)*FONT_WIDTH - 1*FONT_WIDTH, 4*FONT_HEIGHT + LINE_SPACING*3, 0x2193);

  u8g2.sendBuffer();
}

void connectingScreenDisplayBounce(void){
  setCurrentScreen(CONNECTING_SCREEN);
  static unsigned long lastUpdate = 0;
  static uint8_t activeDot = 0;
  static bool direction = true; // true = left to right, false = right to left
  
  unsigned long currentTime = millis();
  
  // Update animation every 500ms
  if (currentTime - lastUpdate >= 500) {
    lastUpdate = currentTime;
    
    // Move to next dot
    if (direction) {
      activeDot++;
      if (activeDot >= 4) { // 5 dots = index 0-4
        activeDot = 4;
        direction = false; // Change direction
      }
    } else {
      activeDot--;
      if (activeDot == 0) {
        direction = true; // Change direction
      }
    }
  }
  
  u8g2.clearBuffer();
  
  // Main text - positioned above center
  const char* mainText = "Connecting to Rocket";
  uint8_t textWidth = strlen(mainText) * FONT_WIDTH;
  uint8_t startX = (u8g2.getDisplayWidth() - textWidth) / 2;
  uint8_t textY = (((OLED_MAX_LINES - 1)/2)*FONT_HEIGHT);
  
  u8g2.setCursor(startX, textY);
  u8g2.print(mainText);
  
  // Bouncing dots positioned below the text
  uint8_t dotsY = textY + FONT_HEIGHT + 4; // Position dots below text with some spacing
  uint8_t dotSpacing = 6; // Small spacing between dots
  uint8_t totalDotsWidth = 4 * dotSpacing; // 5 dots = 4 spaces
  uint8_t dotsStartX = (u8g2.getDisplayWidth() - totalDotsWidth) / 2; // Center the 5 dots
  
  for (uint8_t i = 0; i < 5; i++) {
    uint8_t dotX = dotsStartX + (i * dotSpacing);
    uint8_t dotY;
    
    // Active dot bounces up, others stay down
    if (i == activeDot) {
      dotY = dotsY - 3; // Bounce up 3 pixels
    } else {
      dotY = dotsY; // Normal position
    }
    
    u8g2.setCursor(dotX, dotY);
    u8g2.print(".");
  }
  
  u8g2.sendBuffer();
}